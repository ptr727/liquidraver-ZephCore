## zephcore/boards/esp32/heltec_wifi_lora32_v4/Kconfig.heltec_wifi_lora32_v4
```kconfig
config BOARD_HELTEC_WIFI_LORA32_V4
	select SOC_ESP32S3
	select SOC_ESP32S3_PROCPU if BOARD_HELTEC_WIFI_LORA32_V4_ESP32S3_PROCPU
```

## zephcore/boards/esp32/heltec_wifi_lora32_v43/Kconfig.heltec_wifi_lora32_v43
```kconfig
config BOARD_HELTEC_WIFI_LORA32_V43
	select SOC_ESP32S3
	select SOC_ESP32S3_PROCPU if BOARD_HELTEC_WIFI_LORA32_V43_ESP32S3_PROCPU
```

## zephcore/boards/esp32/heltec_wifi_lora32_v4_r8/Kconfig.heltec_wifi_lora32_v4_r8
```kconfig
config BOARD_HELTEC_WIFI_LORA32_V4_R8
	select SOC_ESP32S3_WROOM_N16R8
	select SOC_ESP32S3_PROCPU if BOARD_HELTEC_WIFI_LORA32_V4_R8_ESP32S3_PROCPU
```

## zephcore/boards/esp32/lilygo_t3s3/Kconfig.lilygo_t3s3
```kconfig
# LilyGo T3S3 board configuration

# SPDX-License-Identifier: MIT

config BOARD_LILYGO_T3S3
	select SOC_ESP32S3
	select SOC_ESP32S3_PROCPU if BOARD_LILYGO_T3S3_ESP32S3_PROCPU
```

## zephcore/boards/esp32/lilygo_tlora_c6/Kconfig.lilygo_tlora_c6
```kconfig
# LilyGo T-LoRa C6 board configuration

# SPDX-License-Identifier: MIT

config BOARD_LILYGO_TLORA_C6
	select SOC_ESP32C6
	select SOC_ESP32C6_HPCORE if BOARD_LILYGO_TLORA_C6_ESP32C6_HPCORE
```

## zephcore/boards/esp32/meshnology_w12/Kconfig.meshnology_w12
```kconfig
config BOARD_MESHNOLOGY_W12
	select SOC_ESP32S3
	select SOC_ESP32S3_PROCPU if BOARD_MESHNOLOGY_W12_ESP32S3_PROCPU
```

## zephcore/boards/esp32/station_g2/Kconfig.station_g2
```kconfig
config BOARD_STATION_G2
	select SOC_ESP32S3
	select SOC_ESP32S3_PROCPU if BOARD_STATION_G2_ESP32S3_PROCPU
```

## zephcore/boards/esp32/thinknode_m7/Kconfig.thinknode_m7
```kconfig
config BOARD_THINKNODE_M7
	select SOC_ESP32S3
	select SOC_ESP32S3_PROCPU if BOARD_THINKNODE_M7_ESP32S3_PROCPU
```

## zephcore/boards/esp32/thinknode_m7/board.yml
```yaml
# Copyright (c) 2026 ZephCore
# SPDX-License-Identifier: MIT

board:
  name: thinknode_m7
  full_name: Elecrow ThinkNode M7 (ESP32-S3 + LR1110 + CH390 Ethernet)
  vendor: elecrow
  socs:
    - name: esp32s3
```

## zephcore/patches/zephyr-new/dts/bindings/ethernet/wch,ch390.yaml
```yaml
# Copyright The Zephyr Project Contributors
# SPDX-License-Identifier: Apache-2.0

description: |
  WCH CH390 10/100BASE-T Ethernet Controller with SPI interface.

  The CH390 is register-compatible with the Davicom DM9051 and is supported by
  the DM9051 driver.

compatible: "wch,ch390"

include: [spi-device.yaml, ethernet-controller.yaml]

properties:
  int-gpios:
    type: phandle-array
    required: true
    description: |
      Interrupt pin of the CH390. The driver configures the pin polarity of the
      controller from the GPIO flags.
```
